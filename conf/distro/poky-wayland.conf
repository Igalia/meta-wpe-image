## conf/distro/poky-wayland.conf
```bitbake
# Distro based on Poky
require conf/distro/poky-altcfg.conf

DISTRO = "poky-wayland"
DISTRO_NAME = "Poky Wayland"
DISTRO_VERSION = "1.0"
DISTRO_CODENAME = "poky-wayland"

DISTROOVERRIDES = "poky:poky-altcfg:linuxstdbase"

DISTRO_FEATURES:append = " egl \
                           opengl \
                           pam \
                           polkit \
                           pulseaudio \
                           virtualization \
                           wayland \
                         "

DISTRO_FEATURES:remove = "ptest"

# Add build information in the image (/etc/buildinfo)
INHERIT += "image-buildinfo"
IMAGE_BUILDINFO_VARS:append = " DATETIME DISTRO_NAME IMAGE_BASENAME MACHINE TUNE_PKGARCH"
IMAGE_BUILDINFO_VARS:append = " MACHINE_FEATURES DISTRO_FEATURES COMMON_FEATURES IMAGE_FEATURES"
IMAGE_BUILDINFO_VARS:append = " TUNE_FEATURES TARGET_FPU"

# Set wpebackend-fdo as wpebackend provider
PREFERRED_PROVIDER_virtual/wpebackend ?= "wpebackend-fdo"

# GStreamer Video decoder
# * v4l2h264dec (by default):
PACKAGECONFIG:append:pn-gstreamer1.0-plugins-bad = " v4l2codecs"
# * GstOMXH264Dec (only software acceleration available for VC4):
# IMAGE_INSTALL:append = " gstreamer1.0-omx"
```

## conf/layer.conf
```bitbake
# We have a conf and classes directory, add to BBPATH
BBPATH .= ":${LAYERDIR}"

# We have recipes-* directories, add to BBFILES
BBFILES += " \
    ${LAYERDIR}/recipes-*/*/*.bb \
    ${LAYERDIR}/recipes-*/*/*.bbappend \
"

BBFILE_COLLECTIONS += "wpeimage"
BBFILE_PATTERN_wpeimage := "^${LAYERDIR}/"
BBFILE_PRIORITY_wpeimage = "10"

LAYERSERIES_COMPAT_wpeimage = "nanbield"
```

## conf/machine/raspberrypi3-64-mesa.conf
```bitbake
require conf/machine/raspberrypi3-64.conf

MACHINEOVERRIDES := "${@'${MACHINEOVERRIDES}'.replace(':${MACHINE}',':raspberrypi3-64:${MACHINE}')}"

PREFERRED_VERSION_linux-raspberrypi = "6.1.%"

MACHINE_FEATURES += "vc4graphics"

RPI_KERNEL_DEVICETREE_OVERLAYS:remove = "overlays/bcm2712d0.dtbo"
RPI_KERNEL_DEVICETREE_OVERLAYS:remove = "overlays/vc4-kms-dsi-ili9881-7inch.dtbo"

GPU_MEM_256 = "128"
GPU_MEM_512 = "128"
GPU_MEM_1024 = "128"
DISABLE_OVERSCAN = "1"
RPI_EXTRA_CONFIG = ' \n \
        hdmi_group=0 \n \
        hdmi_mode=0 \n \
        dtparam=audio=on \n \
        '
```

## conf/machine/raspberrypi3-mesa.conf
```bitbake
require conf/machine/raspberrypi3.conf

PREFERRED_VERSION_linux-raspberrypi = "6.1.%"

RPI_KERNEL_DEVICETREE = " \
    bcm2708-rpi-zero-w.dtb \
    bcm2708-rpi-b.dtb \
    bcm2708-rpi-b-plus.dtb \
    bcm2709-rpi-2-b.dtb \
    bcm2710-rpi-3-b.dtb \
    bcm2710-rpi-3-b-plus.dtb \
    bcm2711-rpi-4-b.dtb \
    bcm2708-rpi-cm.dtb \
    bcm2710-rpi-cm3.dtb \
    "

MACHINEOVERRIDES =. "use-mainline-bsp:raspberrypi3:"

MACHINE_FEATURES += "vc4graphics"

RPI_KERNEL_DEVICETREE_OVERLAYS:remove = "overlays/bcm2712d0.dtbo"

GPU_MEM_256 = "128"
GPU_MEM_512 = "128"
GPU_MEM_1024 = "128"
DISABLE_OVERSCAN = "1"
RPI_EXTRA_CONFIG = ' \n \
        hdmi_group=0 \n \
        hdmi_mode=0 \n \
        dtparam=audio=on \n \
        '
```

## conf/machine/raspberrypi3-userland.conf
```bitbake
require conf/machine/raspberrypi3.conf

MACHINEOVERRIDES =. "raspberrypi3:"

MACHINE_FEATURES:remove = "vc4graphics"

RPI_KERNEL_DEVICETREE_OVERLAYS:remove = "overlays/bcm2712d0.dtbo"
RPI_KERNEL_DEVICETREE_OVERLAYS:remove = "overlays/vc4-kms-dsi-ili9881-7inch.dtbo"

GPU_MEM_256 = "128"
GPU_MEM_512 = "196"
GPU_MEM_1024 = "256"
DISABLE_OVERSCAN = "1"
RPI_EXTRA_CONFIG = ' \n \
        hdmi_group=0 \n \
        hdmi_mode=0 \n \
        dtparam=audio=on \n \
        '
```

## conf/machine/raspberrypi4-mesa.conf
```bitbake
require conf/machine/raspberrypi4.conf

PREFERRED_VERSION_linux-raspberrypi = "6.1.%"

MACHINEOVERRIDES := "${@'${MACHINEOVERRIDES}'.replace(':${MACHINE}',':raspberrypi4:${MACHINE}')}"

GPU_MEM_256 = "128"
GPU_MEM_512 = "196"
GPU_MEM_1024 = "256"
DISABLE_OVERSCAN = "1"
RPI_EXTRA_CONFIG = ' \n \
        hdmi_group=0 \n \
        hdmi_mode=0 \n \
        dtparam=audio=on \n \
        '
```

## conf/machine/wandboard-mesa.conf
```bitbake
#@TYPE: Machine
#@NAME: Wandboard i.MX6 Wandboard QuadPlus/Quad/Dual/Solo
#@SOC: i.MX6QP/Q/DL
#@DESCRIPTION: Machine configuration for i.MX6 Wandboard QuadPlus/Quad/Dual/Solo
#@MAINTAINER: Pablo Saavedra <psaavedra@igalia.com>

MACHINEOVERRIDES =. "mx6q:mx6dl:wandboard:"
# MACHINEOVERRIDES =. "use-mainline-bsp:wandboard:"

include conf/machine/include/imx-base.inc
include conf/machine/include/arm/armv7a/tune-cortexa9.inc

IMX_DEFAULT_BSP = "mainline"

UBOOT_MAKE_TARGET = ""
UBOOT_SUFFIX = "img"
SPL_BINARY = "SPL"
UBOOT_MACHINE = "wandboard_config"

UBOOT_EXTLINUX = "1"
UBOOT_EXTLINUX_KERNEL_ARGS = "rootwait rw video=mxcfb0:dev=hdmi,1920x1080M@60,if=RGB24,bpp=32"
UBOOT_EXTLINUX_ROOT = "root=PARTUUID=${uuid}"
UBOOT_EXTLINUX_CONSOLE = "console=${console},${baudrate}"

WANDBOARD_DEFAULT_KERNEL = "linux-wandboard"
WANDBOARD_DEFAULT_KERNEL:use-mainline-bsp = "linux-fslc"
PREFERRED_PROVIDER_virtual/kernel ?= "${WANDBOARD_DEFAULT_KERNEL}"
KERNEL_DEVICETREE = " \
    imx6dl-wandboard.dtb \
    imx6dl-wandboard-revb1.dtb \
    imx6dl-wandboard-revd1.dtb \
    imx6q-wandboard.dtb \
    imx6q-wandboard-revb1.dtb \
    imx6q-wandboard-revd1.dtb \
    imx6qp-wandboard-revd1.dtb \
"

KERNEL_IMAGETYPE = "zImage"

MACHINE_FEATURES += "bluetooth pci wifi touchscreen"

MACHINE_EXTRA_RRECOMMENDS += " \
  bcm4329-nvram-config \
  bcm4330-nvram-config \
"

SERIAL_CONSOLES = "115200;ttymxc0"

MACHINE_ESSENTIAL_EXTRA_RDEPENDS += " \
    kernel-image \
    kernel-devicetree \
    u-boot-fslc \
"

WKS_FILES = "imx-uboot-spl.wks.in"

SOC_HAS_VIVANTE_KERNEL_DRIVER_SUPPORT:wandboard = "0"
PREFERRED_PROVIDER_virtual/egl = "mesa"
PREFERRED_PROVIDER_virtual/egl:wandboard = "mesa"
PREFERRED_PROVIDER_virtual/libgles1:wandboard = "mesa"
PREFERRED_PROVIDER_virtual/libgles2:wandboard = "mesa"
PREFERRED_PROVIDER_virtual/libg2d:wandboard = "mesa"
PREFERRED_PROVIDER_virtual/mesa = "mesa"
PREFERRED_PROVIDER_virtual/libgles2 = "mesa"

DEFAULTTUNE:wandboard   = "cortexa9thf-neon"
```

## meta-wpe-distro/conf/distro/moonforge-wayland.conf
```bitbake
# Distro based on Moonforge Linux (https://moonforgelinux.org/)
require conf/distro/moonforge.conf

DISTRO = "moonforge-wayland"
DISTRO_NAME = "Moonforge Wayland"
DISTRO_VERSION = "1.0"
DISTRO_CODENAME = "poky-wayland"

DISTROOVERRIDES = "poky:poky-altcfg:linuxstdbase"

DISTRO_FEATURES:append = " egl \
                           opengl \
                           pam \
                           polkit \
                           pulseaudio \
                           virtualization \
                           wayland \
                         "

DISTRO_FEATURES:remove = "ptest"

# Add build information in the image (/etc/buildinfo)
INHERIT += "image-buildinfo"
IMAGE_BUILDINFO_VARS:append = " DATETIME DISTRO_NAME IMAGE_BASENAME MACHINE TUNE_PKGARCH"
IMAGE_BUILDINFO_VARS:append = " MACHINE_FEATURES DISTRO_FEATURES COMMON_FEATURES IMAGE_FEATURES"
IMAGE_BUILDINFO_VARS:append = " TUNE_FEATURES TARGET_FPU"

# GStreamer Video decoder
# * v4l2h264dec (by default):
PACKAGECONFIG:append:pn-gstreamer1.0-plugins-bad = " v4l2codecs"
```

## meta-wpe-distro/conf/distro/wpe.conf
```bitbake
# Distro based on Moonforge
require conf/distro/moonforge-wayland.conf

DISTRO = "wpe"
DISTRO_NAME = "WPE Wayland Distribution"
DISTRO_VERSION = "2.0"
DISTRO_CODENAME = "wpe"

MAINTAINER = "Pablo Saavedra <psaavedra@igalia.com>"
```

## meta-wpe-distro/conf/layer.conf
```bitbake
# We have a conf and classes directory, add to BBPATH
BBPATH .= ":${LAYERDIR}"

# We have recipes-* directories, add to BBFILES
BBFILES += " \
    ${LAYERDIR}/recipes-*/*/*.bb \
    ${LAYERDIR}/recipes-*/*/*.bbappend \
"

BBFILES_DYNAMIC += " \
    raspberrypi:${LAYERDIR}/dynamic-layers/raspberrypi/*/*/*.bb \
    raspberrypi:${LAYERDIR}/dynamic-layers/raspberrypi/*/*/*.bbappend \
    freescale-layer:${LAYERDIR}/dynamic-layers/freescale-layer/*/*/*.bb \
    freescale-layer:${LAYERDIR}/dynamic-layers/freescale-layer/*/*/*.bbappend \
    "

BBFILE_COLLECTIONS += "wpeimage"
BBFILE_PATTERN_wpeimage := "^${LAYERDIR}/"
BBFILE_PRIORITY_wpeimage = "10"

LAYERSERIES_COMPAT_wpeimage = "scarthgap"
```

## meta-wpe-distro/conf/machine/raspberrypi4-mesa.conf
```bitbake
require conf/machine/raspberrypi4.conf

PREFERRED_VERSION_linux-raspberrypi = "6.1.%"

MACHINEOVERRIDES := "${@'${MACHINEOVERRIDES}'.replace(':${MACHINE}',':raspberrypi4:${MACHINE}')}"

RPI_KERNEL_DEVICETREE_OVERLAYS:remove = "overlays/bcm2712d0.dtbo"
RPI_KERNEL_DEVICETREE_OVERLAYS:remove = "overlays/vc4-kms-dsi-ili9881-7inch.dtbo"
RPI_KERNEL_DEVICETREE_OVERLAYS:remove = "overlays/w1-gpio-pi5.dtbo"

GPU_MEM_256 = "128"
GPU_MEM_512 = "196"
GPU_MEM_1024 = "256"
DISABLE_OVERSCAN = "1"
RPI_EXTRA_CONFIG = ' \n \
        hdmi_group=0 \n \
        hdmi_mode=0 \n \
        dtparam=audio=on \n \
        '
```
